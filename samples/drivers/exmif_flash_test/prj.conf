## Kconfig
```
# Copyright (c) 2024 Nordic Semiconductor ASA
# SPDX-License-Identifier: Apache-2.0

mainmenu "EXMIF Flash Test Sample"

config EXMIF_FLASH_TEST_ERASE_ONLY
	bool "Erase only mode"
	default n
	help
	  When enabled, only erases the flash without writing/verifying data.
	  Useful for quickly resetting the flash to a known state.

config EXMIF_FLASH_TEST_FULL_RANGE
	bool "Test full flash range (32MB)"
	default n
	help
	  When enabled, tests the entire 32MB flash range.
	  When disabled, only tests the first 16MB (24-bit addressing).
	  Note: Full range requires 4-byte addressing support.

config EXMIF_FLASH_TEST_SECTOR_SIZE
	int "Flash sector size in bytes"
	default 4096
	help
	  The erase sector size of the flash chip.

config EXMIF_FLASH_TEST_PAGE_SIZE
	int "Flash page size in bytes"
	default 256
	help
	  The page program size of the flash chip.

source "Kconfig.zephyr"
```

## sample.yaml
```
# Copyright (c) 2024 Nordic Semiconductor ASA
# SPDX-License-Identifier: Apache-2.0

sample:
  name: EXMIF Flash Test
  description: Test external flash via EXMIF (W25Q256FW)

tests:
  sample.drivers.exmif_flash_test:
    tags: flash exmif
    platform_allow: nrf54h20dk/nrf54h20/cpuapp
    harness: console
    harness_config:
      type: one_line
      regex:
        - "Result: ALL TESTS PASSED"
```

## prj.conf
```kconfig
# Copyright (c) 2024 Nordic Semiconductor ASA
# SPDX-License-Identifier: Apache-2.0

CONFIG_LOG=y
CONFIG_LOG_DEFAULT_LEVEL=3
CONFIG_LOG_BUFFER_SIZE=4096

CONFIG_STDOUT_CONSOLE=y
CONFIG_PRINTK=y

# GPIO for pin configuration
CONFIG_GPIO=y

# Sample configuration
CONFIG_EXMIF_FLASH_TEST_ERASE_ONLY=n
CONFIG_EXMIF_FLASH_TEST_FULL_RANGE=n
```

## boards/nrf54h20dk_nrf54h20_cpuapp.overlay
```dts
/*
 * Copyright (c) 2024 Nordic Semiconductor ASA
 * SPDX-License-Identifier: Apache-2.0
 *
 * Overlay for W25Q256FW Quad-SPI flash on nRF54H20
 */

&gpio6 {
	status = "okay";
};

&exmif {
	status = "okay";
};
```

## src/main.c
```c
/*
 * Copyright (c) 2024 Nordic Semiconductor ASA
 * SPDX-License-Identifier: Apache-2.0
 */

#include <zephyr/kernel.h>
#include <zephyr/logging/log.h>
#include <string.h>

#include "exmif_spi.h"

LOG_MODULE_REGISTER(flash_test, CONFIG_LOG_DEFAULT_LEVEL);

/* W25Q256FW Flash Parameters */
#define FLASH_SIZE_16MB      0x1000000   /* 16 MB (24-bit addressing) */
#define FLASH_SIZE_32MB      0x2000000   /* 32 MB (full flash) */
#define FLASH_SECTOR_SIZE    CONFIG_EXMIF_FLASH_TEST_SECTOR_SIZE
#define FLASH_PAGE_SIZE      CONFIG_EXMIF_FLASH_TEST_PAGE_SIZE

/* Test configuration */
#if defined(CONFIG_EXMIF_FLASH_TEST_FULL_RANGE) && CONFIG_EXMIF_FLASH_TEST_FULL_RANGE
#define FLASH_TEST_SIZE      FLASH_SIZE_32MB
#define USE_4BYTE_ADDR       true
#else
#define FLASH_TEST_SIZE      FLASH_SIZE_16MB
#define USE_4BYTE_ADDR       false
#endif

/* Buffer for read/write operations */
static uint8_t page_buffer[FLASH_PAGE_SIZE];
static uint8_t verify_buffer[FLASH_PAGE_SIZE];

static int flash_read_status(uint8_t *status)
{
	exmif_spi_transfer_req_t req = {
		.command = FLASH_CMD_READ_STATUS_1,
		.address = ADDRESS_NOT_VALID,
		.direction = EXMIF_SPI_RX,
		.data_buf = status,
		.data_bytes = 1,
		.use_4byte_addr = false,
	};

	return exmif_spi_transceive(&req);
}

static int flash_wait_ready(uint32_t timeout_ms)
{
	uint8_t status;
	uint32_t start = k_uptime_get_32();

	while ((k_uptime_get_32() - start) < timeout_ms) {
		int ret = flash_read_status(&status);
		if (ret != 0) {
			return ret;
		}

		if (!(status & FLASH_STATUS_BUSY)) {
			return 0;
		}

		k_msleep(1);
	}

	LOG_ERR("Flash busy timeout");
	return -ETIMEDOUT;
}

static int flash_write_enable(void)
{
	exmif_spi_transfer_req_t req = {
		.command = FLASH_CMD_WRITE_ENABLE,
		.address = ADDRESS_NOT_VALID,
		.direction = EXMIF_SPI_TX,
		.data_buf = NULL,
		.data_bytes = 0,
		.use_4byte_addr = false,
	};

	int ret = exmif_spi_transceive(&req);
	if (ret != 0) {
		return ret;
	}

	/* Verify WEL bit is set */
	uint8_t status;
	ret = flash_read_status(&status);
	if (ret != 0) {
		return ret;
	}

	if (!(status & FLASH_STATUS_WEL)) {
		LOG_ERR("Write enable failed");
		return -EIO;
	}

	return 0;
}

static int flash_read_jedec_id(uint8_t *id)
{
	exmif_spi_transfer_req_t req = {
		.command = FLASH_CMD_READ_JEDEC_ID,
		.address = ADDRESS_NOT_VALID,
		.direction = EXMIF_SPI_RX,
		.data_buf = id,
		.data_bytes = 3,
		.use_4byte_addr = false,
	};

	return exmif_spi_transceive(&req);
}

static int flash_enter_4byte_mode(void)
{
	exmif_spi_transfer_req_t req = {
		.command = FLASH_CMD_ENTER_4BYTE_MODE,
		.address = ADDRESS_NOT_VALID,
		.direction = EXMIF_SPI_TX,
		.data_buf = NULL,
		.data_bytes = 0,
		.use_4byte_addr = false,
	};

	LOG_INF("Entering 4-byte address mode");
	return exmif_spi_transceive(&req);
}

static int flash_sector_erase(uint32_t address, bool use_4byte)
{
	int ret;

	ret = flash_write_enable();
	if (ret != 0) {
		return ret;
	}

	exmif_spi_transfer_req_t req = {
		.command = use_4byte ? FLASH_CMD_SECTOR_ERASE_4BYTE : FLASH_CMD_SECTOR_ERASE,
		.address = address,
		.direction = EXMIF_SPI_TX,
		.data_buf = NULL,
		.data_bytes = 0,
		.use_4byte_addr = use_4byte,
	};

	ret = exmif_spi_transceive(&req);
	if (ret != 0) {
		return ret;
	}

	/* Wait for erase to complete (sector erase can take up to 400ms) */
	return flash_wait_ready(500);
}

static int flash_page_program(uint32_t address, const uint8_t *data, uint32_t len, bool use_4byte)
{
	int ret;

	if (len > FLASH_PAGE_SIZE) {
		LOG_ERR("Page program size exceeds page size");
		return -EINVAL;
	}

	ret = flash_write_enable();
	if (ret != 0) {
		return ret;
	}

	exmif_spi_transfer_req_t req = {
		.command = use_4byte ? FLASH_CMD_PAGE_PROGRAM_4BYTE : FLASH_CMD_PAGE_PROGRAM,
		.address = address,
		.direction = EXMIF_SPI_TX,
		.data_buf = (uint8_t *)data,
		.data_bytes = len,
		.use_4byte_addr = use_4byte,
	};

	ret = exmif_spi_transceive(&req);
	if (ret != 0) {
		return ret;
	}

	/* Wait for program to complete (page program can take up to 3ms) */
	return flash_wait_ready(10);
}

static int flash_read_data(uint32_t address, uint8_t *data, uint32_t len, bool use_4byte)
{
	exmif_spi_transfer_req_t req = {
		.command = use_4byte ? FLASH_CMD_READ_DATA_4BYTE : FLASH_CMD_READ_DATA,
		.address = address,
		.direction = EXMIF_SPI_RX,
		.data_buf = data,
		.data_bytes = len,
		.use_4byte_addr = use_4byte,
	};

	return exmif_spi_transceive(&req);
}

static void generate_test_pattern(uint8_t *buf, uint32_t len, uint32_t seed)
{
	for (uint32_t i = 0; i < len; i++) {
		buf[i] = (uint8_t)((seed + i) ^ (seed >> 8));
	}
}

static int verify_erased(uint32_t address, uint32_t len, bool use_4byte)
{
	int ret;
	uint32_t offset = 0;

	while (offset < len) {
		uint32_t chunk = MIN(len - offset, FLASH_PAGE_SIZE);

		ret = flash_read_data(address + offset, verify_buffer, chunk, use_4byte);
		if (ret != 0) {
			LOG_ERR("Read failed at 0x%08x", address + offset);
			return ret;
		}

		for (uint32_t i = 0; i < chunk; i++) {
			if (verify_buffer[i] != 0xFF) {
				LOG_ERR("Erase verify failed at 0x%08x: expected 0xFF, got 0x%02x",
					address + offset + i, verify_buffer[i]);
				return -EIO;
			}
		}

		offset += chunk;
	}

	return 0;
}

static int test_sector(uint32_t sector_address, bool use_4byte)
{
	int ret;

	LOG_INF("Testing sector at 0x%08x", sector_address);

	/* Step 1: Erase sector */
	LOG_DBG("  Erasing...");
	ret = flash_sector_erase(sector_address, use_4byte);
	if (ret != 0) {
		LOG_ERR("  Erase failed");
		return ret;
	}

#if !defined(CONFIG_EXMIF_FLASH_TEST_ERASE_ONLY) || !CONFIG_EXMIF_FLASH_TEST_ERASE_ONLY
	/* Step 2: Verify erased */
	LOG_DBG("  Verifying erase...");
	ret = verify_erased(sector_address, FLASH_SECTOR_SIZE, use_4byte);
	if (ret != 0) {
		LOG_ERR("  Erase verify failed");
		return ret;
	}

	/* Step 3: Write test pattern to each page in sector */
	LOG_DBG("  Writing...");
	for (uint32_t page_offset = 0; page_offset < FLASH_SECTOR_SIZE;
	     page_offset += FLASH_PAGE_SIZE) {
		uint32_t page_address = sector_address + page_offset;

		generate_test_pattern(page_buffer, FLASH_PAGE_SIZE, page_address);

		ret = flash_page_program(page_address, page_buffer, FLASH_PAGE_SIZE, use_4byte);
		if (ret != 0) {
			LOG_ERR("  Page program failed at 0x%08x", page_address);
			return ret;
		}
	}

	/* Step 4: Read back and verify */
	LOG_DBG("  Verifying data...");
	for (uint32_t page_offset = 0; page_offset < FLASH_SECTOR_SIZE;
	     page_offset += FLASH_PAGE_SIZE) {
		uint32_t page_address = sector_address + page_offset;

		generate_test_pattern(page_buffer, FLASH_PAGE_SIZE, page_address);

		ret = flash_read_data(page_address, verify_buffer, FLASH_PAGE_SIZE, use_4byte);
		if (ret != 0) {
			LOG_ERR("  Read failed at 0x%08x", page_address);
			return ret;
		}

		if (memcmp(page_buffer, verify_buffer, FLASH_PAGE_SIZE) != 0) {
			LOG_ERR("  Data verify failed at 0x%08x", page_address);
			for (uint32_t i = 0; i < FLASH_PAGE_SIZE; i++) {
				if (page_buffer[i] != verify_buffer[i]) {
					LOG_ERR("    Byte %u: expected 0x%02x, got 0x%02x",
						i, page_buffer[i], verify_buffer[i]);
					break;
				}
			}
			return -EIO;
		}
	}

	/* Step 5: Erase again and verify */
	LOG_DBG("  Final erase...");
	ret = flash_sector_erase(sector_address, use_4byte);
	if (ret != 0) {
		LOG_ERR("  Final erase failed");
		return ret;
	}

	ret = verify_erased(sector_address, FLASH_SECTOR_SIZE, use_4byte);
	if (ret != 0) {
		LOG_ERR("  Final erase verify failed");
		return ret;
	}
#endif /* !CONFIG_EXMIF_FLASH_TEST_ERASE_ONLY */

	LOG_INF("  Sector 0x%08x: PASSED", sector_address);
	return 0;
}

int main(void)
{
	int ret;
	uint8_t jedec_id[3];
	uint32_t sectors_tested = 0;
	uint32_t sectors_failed = 0;
	uint32_t total_sectors = FLASH_TEST_SIZE / FLASH_SECTOR_SIZE;

	LOG_INF("===========================================");
	LOG_INF("EXMIF Flash Test Sample");
	LOG_INF("===========================================");
	LOG_INF("Flash size to test: %u MB", FLASH_TEST_SIZE / (1024 * 1024));
	LOG_INF("Sector size: %u bytes", FLASH_SECTOR_SIZE);
	LOG_INF("Total sectors: %u", total_sectors);
#if defined(CONFIG_EXMIF_FLASH_TEST_ERASE_ONLY) && CONFIG_EXMIF_FLASH_TEST_ERASE_ONLY
	LOG_INF("Mode: ERASE ONLY");
#else
	LOG_INF("Mode: FULL TEST (write/verify/erase)");
#endif
	LOG_INF("===========================================");

	/* Initialize EXMIF */
	ret = exmif_spi_init();
	if (ret != 0) {
		LOG_ERR("EXMIF init failed: %d", ret);
		return ret;
	}

	/* Read JEDEC ID */
	ret = flash_read_jedec_id(jedec_id);
	if (ret != 0) {
		LOG_ERR("Failed to read JEDEC ID: %d", ret);
		return ret;
	}

	LOG_INF("JEDEC ID: %02x %02x %02x", jedec_id[0], jedec_id[1], jedec_id[2]);

	/* Verify it's a Winbond flash */
	if (jedec_id[0] != 0xEF) {
		LOG_WRN("Unexpected manufacturer ID (expected 0xEF for Winbond)");
	}

	/* Enter 4-byte address mode if testing full range */
	if (USE_4BYTE_ADDR) {
		ret = flash_enter_4byte_mode();
		if (ret != 0) {
			LOG_ERR("Failed to enter 4-byte mode: %d", ret);
			return ret;
		}
	}

	LOG_INF("Starting flash test...");
	uint32_t start_time = k_uptime_get_32();

	/* Test each sector */
	for (uint32_t sector = 0; sector < total_sectors; sector++) {
		uint32_t sector_address = sector * FLASH_SECTOR_SIZE;

		ret = test_sector(sector_address, USE_4BYTE_ADDR);
		if (ret != 0) {
			sectors_failed++;
			LOG_ERR("Sector %u (0x%08x) FAILED", sector, sector_address);
		} else {
			sectors_tested++;
		}

		/* Progress report every 256 sectors (1MB) */
		if ((sector + 1) % 256 == 0) {
			uint32_t mb_done = (sector + 1) * FLASH_SECTOR_SIZE / (1024 * 1024);
			LOG_INF("Progress: %u MB / %u MB tested",
				mb_done, FLASH_TEST_SIZE / (1024 * 1024));
		}
	}

	uint32_t elapsed_ms = k_uptime_get_32() - start_time;

	LOG_INF("===========================================");
	LOG_INF("Flash Test Complete");
	LOG_INF("===========================================");
	LOG_INF("Sectors tested: %u", sectors_tested);
	LOG_INF("Sectors failed: %u", sectors_failed);
	LOG_INF("Time elapsed: %u.%03u seconds", elapsed_ms / 1000, elapsed_ms % 1000);
	if (sectors_failed == 0) {
		LOG_INF("Result: ALL TESTS PASSED");
	} else {
		LOG_ERR("Result: %u FAILURES", sectors_failed);
	}
	LOG_INF("===========================================");

	return (sectors_failed == 0) ? 0 : -1;
}
```

## src/exmif_spi.c
```c
/*
 * Copyright (c) 2024 Nordic Semiconductor ASA
 * SPDX-License-Identifier: Apache-2.0
 */

#include <zephyr/kernel.h>
#include <zephyr/logging/log.h>
#include <zephyr/sys/util.h>
#include <hal/nrf_gpio.h>

#include "exmif_spi.h"

LOG_MODULE_REGISTER(exmif_spi, CONFIG_LOG_DEFAULT_LEVEL);

static NRF_EXMIF_Type *exmif = (NRF_EXMIF_Type *)DT_REG_ADDR(DT_NODELABEL(exmif));

static void exmif_init_gpios(void)
{
	LOG_INF("Configuring EXMIF GPIOs");

	const uint32_t pin_mask = ((1 << 0) |   /* CLK */
				   (1 << 3) |   /* CS_n */
				   (1 << 5) |   /* DQ1/MISO */
				   (1 << 7) |   /* DQ0/MOSI */
				   (1 << 9) |   /* DQ3/HOLD */
				   (1 << 10));  /* DQ2/WP_n */

	NRF_P6_S->RETAINCLR = pin_mask;

	NRF_P6_S->PORTCNF.DRIVECTRL =
		(GPIO_PORTCNF_DRIVECTRL_IMPEDANCE50_Enable << GPIO_PORTCNF_DRIVECTRL_IMPEDANCE50_Pos);

	for (uint32_t i = 0; i < 14; i++) {
		if ((1 << i) & pin_mask) {
			NRF_P6_S->PIN_CNF[i] =
				((GPIO_PIN_CNF_DIR_Input << GPIO_PIN_CNF_DIR_Pos) |
				 (GPIO_PIN_CNF_INPUT_Connect << GPIO_PIN_CNF_INPUT_Pos) |
				 (GPIO_PIN_CNF_DRIVE0_H0 << GPIO_PIN_CNF_DRIVE0_Pos) |
				 (GPIO_PIN_CNF_DRIVE1_H1 << GPIO_PIN_CNF_DRIVE1_Pos) |
				 (GPIO_PIN_CNF_CTRLSEL_EXMIF << GPIO_PIN_CNF_CTRLSEL_Pos));
		}
	}
}

static void exmif_reset_module(void)
{
	uint32_t delay_us = 5;

	LOG_DBG("Resetting EXMIF module");
	exmif->RESET = 0x01;
	k_busy_wait(delay_us);
	exmif->RESET = 0x00;
	k_busy_wait(delay_us);
}

static inline void exmif_enable_slave(void)
{
	exmif->CORE.SSICADDRESS.SER =
		((EXMIF_CORE_SSICADDRESS_SER_SER_SELECTED << EXMIF_CORE_SSICADDRESS_SER_SER_Pos) &
		 EXMIF_CORE_SSICADDRESS_SER_SER_Msk);
}

static inline void exmif_disable_slave(void)
{
	exmif->CORE.SSICADDRESS.SER =
		((EXMIF_CORE_SSICADDRESS_SER_SER_NOTSELECTED << EXMIF_CORE_SSICADDRESS_SER_SER_Pos) &
		 EXMIF_CORE_SSICADDRESS_SER_SER_Msk);
}

static inline void exmif_enable_ssi_controller(void)
{
	exmif->CORE.SSICADDRESS.SSIENR =
		((EXMIF_CORE_SSICADDRESS_SSIENR_SSICEN_ENABLED
		  << EXMIF_CORE_SSICADDRESS_SSIENR_SSICEN_Pos) &
		 EXMIF_CORE_SSICADDRESS_SSIENR_SSICEN_Msk);
}

static inline void exmif_disable_ssi_controller(void)
{
	exmif->CORE.SSICADDRESS.SSIENR =
		((EXMIF_CORE_SSICADDRESS_SSIENR_SSICEN_DISABLE
		  << EXMIF_CORE_SSICADDRESS_SSIENR_SSICEN_Pos) &
		 EXMIF_CORE_SSICADDRESS_SSIENR_SSICEN_Msk);
}

static void exmif_configure_transfer(const exmif_spi_transfer_req_t *req)
{
	uint32_t ctrlr0 = 0;
	uint32_t ctrlr1 = 0;
	uint32_t tmod;
	uint32_t addr_len;

	(void)exmif->CORE.SSICADDRESS.SR;

	/* Power up EXMIF */
	exmif->TASKS_START = 0x1;
	while (!(exmif->EVENTS_STARTED & 0x1)) {
		k_busy_wait(1);
	}

	exmif_disable_ssi_controller();

	/* Determine transfer mode */
	if (req->direction == EXMIF_SPI_RX) {
		tmod = EXMIF_CORE_SSICADDRESS_CTRLR0_TMOD_EEPROM_READ;
	} else {
		tmod = EXMIF_CORE_SSICADDRESS_CTRLR0_TMOD_TX_ONLY;
	}

	/* Configure data frame size (8-bit) */
	ctrlr0 |= ((EXMIF_CORE_SSICADDRESS_CTRLR0_DFS_DFS_08_BIT
		    << EXMIF_CORE_SSICADDRESS_CTRLR0_DFS_Pos) &
		   EXMIF_CORE_SSICADDRESS_CTRLR0_DFS_Msk);

	/* Configure frame format (SPI) */
	ctrlr0 |= ((EXMIF_CORE_SSICADDRESS_CTRLR0_FRF_SPI << EXMIF_CORE_SSICADDRESS_CTRLR0_FRF_Pos) &
		   EXMIF_CORE_SSICADDRESS_CTRLR0_FRF_Msk);

	/* Configure transfer mode */
	ctrlr0 |= ((tmod << EXMIF_CORE_SSICADDRESS_CTRLR0_TMOD_Pos) &
		   EXMIF_CORE_SSICADDRESS_CTRLR0_TMOD_Msk);

	/* Configure clock polarity and phase (Mode 0: CPOL=0, CPHA=0) */
	ctrlr0 |= ((EXMIF_CORE_SSICADDRESS_CTRLR0_SCPH_START_BIT
		    << EXMIF_CORE_SSICADDRESS_CTRLR0_SCPH_Pos) &
		   EXMIF_CORE_SSICADDRESS_CTRLR0_SCPH_Msk);
	ctrlr0 |= ((EXMIF_CORE_SSICADDRESS_CTRLR0_SCPOL_INACTIVE_LOW
		    << EXMIF_CORE_SSICADDRESS_CTRLR0_SCPOL_Pos) &
		   EXMIF_CORE_SSICADDRESS_CTRLR0_SCPOL_Msk);

	/* Standard SPI mode (1-bit) */
	ctrlr0 |= ((EXMIF_CORE_SSICADDRESS_CTRLR0_SPIFRF_SPI_STANDARD
		    << EXMIF_CORE_SSICADDRESS_CTRLR0_SPIFRF_Pos) &
		   EXMIF_CORE_SSICADDRESS_CTRLR0_SPIFRF_Msk);

	/* Set number of data frames for RX modes */
	if (tmod == EXMIF_CORE_SSICADDRESS_CTRLR0_TMOD_RX_ONLY ||
	    tmod == EXMIF_CORE_SSICADDRESS_CTRLR0_TMOD_EEPROM_READ) {
		ctrlr1 = (req->data_bytes > 0) ? (req->data_bytes - 1) : 0;
	}

	/* Determine address length */
	if (req->use_4byte_addr) {
		addr_len = EXMIF_CORE_SSICADDRESS_SPICTRLR0_ADDRL_ADDR_L32;
	} else {
		addr_len = EXMIF_CORE_SSICADDRESS_SPICTRLR0_ADDRL_ADDR_L24;
	}

	exmif->CORE.SSICADDRESS.CTRLR0 = ctrlr0;
	exmif->CORE.SSICADDRESS.CTRLR1 = ctrlr1;

	exmif->CORE.SSICADDRESS.SPICTRLR0 =
		((EXMIF_CORE_SSICADDRESS_SPICTRLR0_TRANSTYPE_TT0
		  << EXMIF_CORE_SSICADDRESS_SPICTRLR0_TRANSTYPE_Pos) &
		 EXMIF_CORE_SSICADDRESS_SPICTRLR0_TRANSTYPE_Msk) |
		((addr_len << EXMIF_CORE_SSICADDRESS_SPICTRLR0_ADDRL_Pos) &
		 EXMIF_CORE_SSICADDRESS_SPICTRLR0_ADDRL_Msk) |
		((EXMIF_CORE_SSICADDRESS_SPICTRLR0_INSTL_INST_L8
		  << EXMIF_CORE_SSICADDRESS_SPICTRLR0_INSTL_Pos) &
		 EXMIF_CORE_SSICADDRESS_SPICTRLR0_INSTL_Msk) |
		((1UL << EXMIF_CORE_SSICADDRESS_SPICTRLR0_CLKSTRETCHEN_Pos) &
		 EXMIF_CORE_SSICADDRESS_SPICTRLR0_CLKSTRETCHEN_Msk);

	/* Set baud rate divider */
	exmif->CORE.SSICADDRESS.BAUDR =
		((8 << EXMIF_CORE_SSICADDRESS_BAUDR_SCKDV_Pos) &
		 EXMIF_CORE_SSICADDRESS_BAUDR_SCKDV_Msk);

	/* Set FIFO thresholds */
	exmif->CORE.SSICADDRESS.TXFTLR =
		((0UL << EXMIF_CORE_SSICADDRESS_TXFTLR_TFT_Pos) &
		 EXMIF_CORE_SSICADDRESS_TXFTLR_TFT_Msk);
	exmif->CORE.SSICADDRESS.RXFTLR =
		((0UL << EXMIF_CORE_SSICADDRESS_RXFTLR_RFT_Pos) &
		 EXMIF_CORE_SSICADDRESS_RXFTLR_RFT_Msk);

	exmif_disable_slave();
}

static int exmif_wait_transfer_complete(void)
{
	uint32_t timeout = 100000;

	while (timeout--) {
		uint32_t sr = exmif->CORE.SSICADDRESS.SR;
		if (!(sr & EXMIF_CORE_SSICADDRESS_SR_BUSY_Msk)) {
			return 0;
		}
		k_busy_wait(1);
	}

	LOG_ERR("Transfer timeout");
	return -ETIMEDOUT;
}

static int exmif_tx_data(const exmif_spi_transfer_req_t *req)
{
	bool slave_enabled = false;
	uint8_t prefix[6];
	uint32_t prefix_len = 0;

	/* Add command */
	prefix[prefix_len++] = req->command;

	/* Add address if valid */
	if (req->address != ADDRESS_NOT_VALID) {
		if (req->use_4byte_addr) {
			prefix[prefix_len++] = (uint8_t)((req->address >> 24) & 0xFF);
		}
		prefix[prefix_len++] = (uint8_t)((req->address >> 16) & 0xFF);
		prefix[prefix_len++] = (uint8_t)((req->address >> 8) & 0xFF);
		prefix[prefix_len++] = (uint8_t)(req->address & 0xFF);
	}

	/* Calculate total TX length */
	uint32_t total_tx_len = prefix_len;
	if (req->direction == EXMIF_SPI_TX && req->data_buf != NULL) {
		total_tx_len += req->data_bytes;
	}

	for (uint32_t i = 0; i < total_tx_len; i++) {
		uint8_t byte_to_write;

		if (i < prefix_len) {
			byte_to_write = prefix[i];
		} else {
			byte_to_write = req->data_buf[i - prefix_len];
		}

		/* Wait for TX FIFO space */
		if (!(exmif->CORE.SSICADDRESS.SR & EXMIF_CORE_SSICADDRESS_SR_TFNF_Msk)) {
			if (!slave_enabled) {
				exmif_enable_slave();
				slave_enabled = true;
			}
			while (!(exmif->CORE.SSICADDRESS.SR & EXMIF_CORE_SSICADDRESS_SR_TFNF_Msk)) {
				__NOP();
			}
		}
		exmif->CORE.SSICADDRESS.DR[0] = byte_to_write;
	}

	if (!slave_enabled) {
		exmif_enable_slave();
	}

	return 0;
}

static int exmif_rx_data(uint8_t *data, uint32_t len)
{
	while (len) {
		uint32_t rxflr = exmif->CORE.SSICADDRESS.RXFLR & EXMIF_CORE_SSICADDRESS_RXFLR_RXTFL_Msk;
		while (rxflr && len) {
			*data++ = exmif->CORE.SSICADDRESS.DR[0];
			rxflr--;
			len--;
		}
	}

	return 0;
}

int exmif_spi_init(void)
{
	LOG_INF("Initializing EXMIF SPI");

	exmif_init_gpios();

	/* Power up EXMIF */
	exmif->TASKS_START = 0x1;
	while (!(exmif->EVENTS_STARTED & 0x1)) {
		k_busy_wait(1);
	}

	exmif_reset_module();

	exmif_enable_ssi_controller();
	k_busy_wait(5);
	exmif_disable_ssi_controller();

	LOG_INF("EXMIF SPI initialized");
	return 0;
}

int exmif_spi_transceive(const exmif_spi_transfer_req_t *req)
{
	int ret;

	exmif_configure_transfer(req);
	exmif_enable_ssi_controller();

	switch (req->direction) {
	case EXMIF_SPI_TX:
		ret = exmif_tx_data(req);
		break;

	case EXMIF_SPI_RX:
		ret = exmif_tx_data(req);
		if (ret != 0) {
			break;
		}
		ret = exmif_rx_data(req->data_buf, req->data_bytes);
		break;

	default:
		LOG_ERR("Invalid direction");
		ret = -EINVAL;
		break;
	}

	if (ret == 0) {
		ret = exmif_wait_transfer_complete();
	}

	exmif_disable_slave();
	exmif_disable_ssi_controller();

	return ret;
}
```

## src/exmif_spi.h
```c
/*
 * Copyright (c) 2024 Nordic Semiconductor ASA
 * SPDX-License-Identifier: Apache-2.0
 */

#ifndef EXMIF_SPI_H
#define EXMIF_SPI_H

#include <stdint.h>
#include <stdbool.h>

#define ADDRESS_NOT_VALID 0xFFFFFFFF

typedef enum {
	EXMIF_SPI_TX = 0,
	EXMIF_SPI_RX = 1,
} exmif_spi_direction_t;

typedef struct {
	uint8_t command;
	uint32_t address;
	exmif_spi_direction_t direction;
	uint8_t *data_buf;
	uint32_t data_bytes;
	bool use_4byte_addr;
} exmif_spi_transfer_req_t;

/**
 * @brief Initialize the EXMIF SPI controller
 * @return 0 on success, negative error code on failure
 */
int exmif_spi_init(void);

/**
 * @brief Perform an SPI transfer
 * @param req Transfer request parameters
 * @return 0 on success, negative error code on failure
 */
int exmif_spi_transceive(const exmif_spi_transfer_req_t *req);

/* W25Q256FW Flash Commands */
#define FLASH_CMD_WRITE_ENABLE       0x06
#define FLASH_CMD_WRITE_DISABLE      0x04
#define FLASH_CMD_READ_STATUS_1      0x05
#define FLASH_CMD_READ_STATUS_2      0x35
#define FLASH_CMD_WRITE_STATUS       0x01
#define FLASH_CMD_READ_DATA          0x03
#define FLASH_CMD_READ_DATA_4BYTE    0x13
#define FLASH_CMD_PAGE_PROGRAM       0x02
#define FLASH_CMD_PAGE_PROGRAM_4BYTE 0x12
#define FLASH_CMD_SECTOR_ERASE       0x20
#define FLASH_CMD_SECTOR_ERASE_4BYTE 0x21
#define FLASH_CMD_BLOCK_ERASE_32K    0x52
#define FLASH_CMD_BLOCK_ERASE_64K    0xD8
#define FLASH_CMD_CHIP_ERASE         0xC7
#define FLASH_CMD_READ_JEDEC_ID      0x9F
#define FLASH_CMD_ENTER_4BYTE_MODE   0xB7
#define FLASH_CMD_EXIT_4BYTE_MODE    0xE9
#define FLASH_CMD_RELEASE_POWERDOWN  0xAB

/* Status Register bits */
#define FLASH_STATUS_BUSY            0x01
#define FLASH_STATUS_WEL             0x02

#endif /* EXMIF_SPI_H */
```
