## modules/hal_nordic/nrfs/Kconfig
```kconfig
# Copyright (c) 2024 Nordic Semiconductor ASA
# SPDX-License-Identifier: Apache-2.0

config NRF_HAS_NRFS
	bool

config NRFS_HAS_CLOCK_SERVICE
	bool

config NRFS_HAS_CONST_LATENCY_SERVICE
	bool

config NRFS_HAS_DIAG_SERVICE
	bool

config NRFS_HAS_DVFS_SERVICE
	bool

config NRFS_HAS_MRAM_SERVICE
	bool

config NRFS_HAS_PMIC_SERVICE
	bool

config NRFS_HAS_RESET_SERVICE
	bool

config NRFS_HAS_TEMP_SERVICE
	bool

config NRFS_HAS_VBUS_DETECTOR_SERVICE
	bool

menu "nRF Services"
	depends on NRF_HAS_NRFS

config NRFS
	bool "nRF Services Support"
	select NRFS_LOCAL_DOMAIN if (SOC_NRF54H20_CPUAPP || SOC_NRF54H20_CPURAD)
	depends on NRF_HAS_NRFS
	help
	  This option enables the nRF Services library

config NRFS_LOCAL_DOMAIN
	bool "nRF Services Local Domain Support"
	select NRFS_BACKEND_IPC_SERVICE
	help
	  This option enables the nRF Services Local Domain libraries

config NRFS_BACKEND_IPC_SERVICE
	bool "IPC service backend for NRFS"
	depends on NRFS
	select IPC_SERVICE
	select IPC_SERVICE_BACKEND_ICMSG
	select MBOX
	select EVENTS
	select REBOOT
	help
	  This option enables transport protocol for the NRFS

config NRFS_DVFS_LOCAL_DOMAIN
	bool "Local domain that supports DVFS"
	depends on NRFS
	depends on NRFS_LOCAL_DOMAIN
	depends on SOC_NRF54H20_CPUAPP
	default y if NRFS_DVFS_SERVICE_ENABLED


menu "Enabled Services"
depends on NRFS
module = NRFS
module-str = nRF-Services
source "subsys/logging/Kconfig.template.log_config"

config NRFS_RESET_SERVICE_ENABLED
	bool "Reset service"
	depends on NRFS_HAS_RESET_SERVICE
	default n

config NRFS_MRAM_SERVICE_ENABLED
	bool "MRAM latency service"
	depends on NRFS_HAS_MRAM_SERVICE
	default y

config NRFS_TEMP_SERVICE_ENABLED
	bool "Temperature service"
	depends on NRFS_HAS_TEMP_SERVICE
	default y

config NRFS_VBUS_DETECTOR_SERVICE_ENABLED
	bool "VBUS detector for the USB peripheral"
	depends on NRFS_HAS_VBUS_DETECTOR_SERVICE
	default y

config NRFS_CONST_LATENCY_SERVICE_ENABLED
	bool "DPPI constant latency service"
	depends on NRFS_HAS_CONST_LATENCY_SERVICE
	default y

config NRFS_PMIC_SERVICE_ENABLED
	bool "PMIC service"
	depends on NRFS_HAS_PMIC_SERVICE
	default n

config NRFS_DVFS_SERVICE_ENABLED
	bool "DVFS service"
	depends on NRFS_HAS_DVFS_SERVICE
	default y if SOC_NRF54H20_CPUAPP
	default n

config NRFS_DIAG_SERVICE_ENABLED
	bool "System Diagnostics service (only for development purposes)"
	depends on NRFS_HAS_DIAG_SERVICE
	default n

config NRFS_CLOCK_SERVICE_ENABLED
	bool "Clock service"
	depends on NRFS_HAS_CLOCK_SERVICE
	default y
endmenu

rsource "backends/Kconfig"
rsource "dvfs/Kconfig"

endmenu
```

## samples/bluetooth/hci_rpmsg/Kconfig
```kconfig
menu "HCI RPMSG"

config HCI_RPMSG
	bool "Use HCI RPMSG"

#if HCI_RPMSG
#module=HCI_RPMSG
#source "${ZEPHYR_BASE}/../nrf/subsys/partition_manager/Kconfig.template.build_strategy"
#endif
```

## samples/drivers/soc_flash_nrf/sample.yaml
```yaml
sample:
  name: SoC Flash on NRF52
tests:
  test:
    platform_whitelist: nrf52_pca10040 nrf9160_pca10090 nrf9160_pca10090ns
    tags: flash nrf52
```
